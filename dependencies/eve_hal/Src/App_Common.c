/*

Copyright (c) Bridgetek Pte Ltd

THIS SOFTWARE IS PROVIDED BY BRIDGETEK PTE LTD "AS IS"
AND ANY EXPRESS OR IMPLIED WARRANTIES, INCLUDING, BUT NOT LIMITED TO, THE IMPLIED WARRANTIES
OF MERCHANTABILITY AND FITNESS FOR A PARTICULAR PURPOSE ARE DISCLAIMED. IN NO EVENT SHALL
BRIDGETEK PTE LTD BE LIABLE FOR ANY DIRECT, INDIRECT, INCIDENTAL,
SPECIAL, EXEMPLARY, OR CONSEQUENTIAL DAMAGES (INCLUDING, BUT NOT LIMITED TO, PROCUREMENT
OF SUBSTITUTE GOODS OR SERVICES LOSS OF USE, DATA, OR PROFITS OR BUSINESS INTERRUPTION)
HOWEVER CAUSED AND ON ANY THEORY OF LIABILITY, WHETHER IN CONTRACT, STRICT LIABILITY, OR
TORT (INCLUDING NEGLIGENCE OR OTHERWISE) ARISING IN ANY WAY OUT OF THE USE OF THIS SOFTWARE,
EVEN IF ADVISED OF THE POSSIBILITY OF SUCH DAMAGE.

BRIDGETEK DRIVERS MAY BE USED ONLY IN CONJUNCTION WITH PRODUCTS BASED ON BRIDGETEK PARTS.

BRIDGETEK DRIVERS MAY BE DISTRIBUTED IN ANY FORM AS LONG AS LICENSE INFORMATION IS NOT MODIFIED.

IF A CUSTOM VENDOR ID AND/OR PRODUCT ID OR DESCRIPTION STRING ARE USED, IT IS THE
RESPONSIBILITY OF THE PRODUCT MANUFACTURER TO MAINTAIN ANY CHANGES AND SUBSEQUENT WHQL
RE-CERTIFICATION AS A RESULT OF MAKING THESE CHANGES.

Abstract:

Application to demonstrate function of EVE.

Author : Bridgetek

Revision History:
0.1 - date 2017.03.24 - Initial version
*/
#include "Platform.h"
#include "App_Common.h"


#if ( defined(FT900_PLATFORM) || defined(FT93X_PLATFORM) )
#include "ff.h"

#endif

/*************************************************************************************************
*                      These functions work with FT8XX GPU buffer  
**************************************************************************************************/
uint32_t CmdBuffer_Index;
volatile uint32_t DlBuffer_Index;

#ifdef BUFFER_OPTIMIZATION
uint8_t  DlBuffer[DL_SIZE];
uint8_t  CmdBuffer[CMD_FIFO_SIZE];
#endif

void App_WrCoCmd_Buffer(Gpu_Hal_Context_t *phost,uint32_t cmd)
{
#ifdef  BUFFER_OPTIMIZATION
    /* Copy the command instruction into buffer */
    uint32_t *pBuffcmd;
	/* Prevent buffer overflow */
	if (CmdBuffer_Index >= CMD_FIFO_SIZE)
	{
		//printf("CmdBuffer overflow\n");

		if (CmdBuffer_Index > 0) {
			Gpu_Hal_WrCmdBuf(phost, CmdBuffer, CmdBuffer_Index);//This blocking state may be infinite due to Display list overflow
		}
		CmdBuffer_Index = 0;
	}

	pBuffcmd = (uint32_t*)&CmdBuffer[CmdBuffer_Index];
	*pBuffcmd = cmd;


#endif

#if ( defined(FT900_PLATFORM) || defined(FT93X_PLATFORM) || defined(ARDUINO_PLATFORM) )
    Gpu_Hal_WrCmd32(phost,cmd);
#endif
    /* Increment the command index */
    CmdBuffer_Index += CMD_SIZE;
}

void App_WrDl_Buffer(Gpu_Hal_Context_t *phost,uint32_t cmd)
{
#ifdef BUFFER_OPTIMIZATION  
    /* Copy the command instruction into buffer */
    uint32_t *pBuffcmd;
	/* Prevent buffer overflow */
	if (DlBuffer_Index < DL_SIZE)
	{
		pBuffcmd = (uint32_t*)&DlBuffer[DlBuffer_Index];
		*pBuffcmd = cmd;
	}
	else
	{
		printf("DlBuffer overflow\n");
	}

#endif

#if ( defined(FT900_PLATFORM) || defined(FT93X_PLATFORM) || defined(ARDUINO_PLATFORM) )
    Gpu_Hal_Wr32(phost,(RAM_DL+DlBuffer_Index),cmd);
#endif
    /* Increment the command index */
    DlBuffer_Index += CMD_SIZE;  
}

void App_WrCoStr_Buffer(Gpu_Hal_Context_t *phost,const char8_t *s)
{
#ifdef  BUFFER_OPTIMIZATION  
    uint16_t length = 0;

	if (CmdBuffer_Index >= CMD_FIFO_SIZE)
	{
		printf("CmdBuffer overflow\n");

		if (CmdBuffer_Index > 0) {
			Gpu_Hal_WrCmdBuf(phost, CmdBuffer, CmdBuffer_Index);//This blocking state may be infinite due to Display list overflow
		}
		CmdBuffer_Index = 0;
	}


	length = strlen(s) + 1;//last for the null termination

    strcpy((char*)&CmdBuffer[CmdBuffer_Index],s);  

    /* increment the length and align it by 4 bytes */
    CmdBuffer_Index += ((length + 3) & ~3);  
#endif  
}

void App_Flush_DL_Buffer(Gpu_Hal_Context_t *phost)
{
#ifdef  BUFFER_OPTIMIZATION
    if (DlBuffer_Index> 0)
    Gpu_Hal_WrMem(phost,RAM_DL,DlBuffer,DlBuffer_Index);
#endif
    DlBuffer_Index = 0;

}

void App_Flush_Co_Buffer(Gpu_Hal_Context_t *phost)
{
#ifdef  BUFFER_OPTIMIZATION    
    if (CmdBuffer_Index > 0)
    Gpu_Hal_WrCmdBuf(phost,CmdBuffer,CmdBuffer_Index);
#endif     
    CmdBuffer_Index = 0;
}

void App_Flush_Co_Buffer_nowait(Gpu_Hal_Context_t *phost)
{
#ifdef  BUFFER_OPTIMIZATION    
	if (CmdBuffer_Index > 0)
		Gpu_Hal_WrCmdBuf_nowait(phost, CmdBuffer, CmdBuffer_Index);
#endif     
	CmdBuffer_Index = 0;
}

void App_Set_DlBuffer_Index(uint32_t index)
{
    DlBuffer_Index = index;
}

void App_Set_CmdBuffer_Index(uint32_t index)
{
    CmdBuffer_Index = index;
}
/*************************************************************************************************
*                      Application Utilities
**************************************************************************************************/

static uint8_t sk=0;
uint8_t App_Read_Tag(Gpu_Hal_Context_t *phost)
{
    static uint8_t Read_tag=0,temp_tag=0,ret_tag=0;
    Read_tag = Gpu_Hal_Rd8(phost,REG_TOUCH_TAG);
    ret_tag = 0;
    if(Read_tag!=0)                                // Allow if the Key is released
    {
        if(temp_tag!=Read_tag)
        {
            temp_tag = Read_tag;
            sk = Read_tag;                                        // Load the Read tag to temp variable
        }
    }
    else
    {
        if(temp_tag!=0)
        {
            ret_tag = temp_tag;
            temp_tag = 0; //The event will be processed. Clear the tag
        }
        sk = 0;
    }
    return ret_tag;
}

uint8_t App_Touch_Update(Gpu_Hal_Context_t *phost, uint8_t *currTag, uint16_t *x, uint16_t *y)
{
	static uint8_t Read_tag = 0, temp_tag = 0, ret_tag = 0;
	uint32_t touch;
	Read_tag = Gpu_Hal_Rd8(phost, REG_TOUCH_TAG);
	ret_tag = 0;
	if (Read_tag != 0)                                // Allow if the Key is released
	{
		if (temp_tag != Read_tag)
		{
			temp_tag = Read_tag;
			sk = Read_tag;                                        // Load the Read tag to temp variable
		}
	}
	else
	{
		if (temp_tag != 0)
		{
			ret_tag = temp_tag;
			temp_tag = 0; //The event will be processed. Clear the tag
		}
		sk = 0;
	}
	*currTag = Read_tag;
	touch = Gpu_Hal_Rd32(phost, REG_TOUCH_SCREEN_XY); 
	*x = (uint16_t)(touch >> 16);
	*y = (uint16_t)(touch & 0xFFFF);
	return ret_tag;
}
void App_Play_Sound(Gpu_Hal_Context_t *phost, uint8_t sound,uint8_t vol,uint8_t midi)
{
    uint16_t val = (midi << 8) | sound; 
    Gpu_Hal_Wr8(phost,REG_VOL_SOUND,vol);
    Gpu_Hal_Wr16(phost,REG_SOUND,val);
    Gpu_Hal_Wr8(phost,REG_PLAY,1); 
}


void App_Calibrate_Screen(Gpu_Hal_Context_t *phost)
{
    Gpu_CoCmd_Dlstart(phost);
    App_WrCoCmd_Buffer(phost,CLEAR(1,1,1));
    App_WrCoCmd_Buffer(phost,COLOR_RGB(255,255,255));
    Gpu_CoCmd_Text(phost,DispWidth/2,DispHeight/2,26,OPT_CENTERX|OPT_CENTERY,"Please tap on a dot");

    /* Calibration */
    Gpu_CoCmd_Calibrate(phost,0);
    App_Flush_Co_Buffer(phost);
    Gpu_Hal_WaitCmdfifo_empty(phost);
}


/* This image contains cells: 32x32
Cell 0: Home
Cell 1: Star
Cell 2: Down triangle
Cell 3: Up triangle
Cell 4: Right triangle (Play button icon)
Size: 460 bytes */
PROGMEM prog_uchar8_t home_start_icon[SIZE_HOME_START_ICON] = {0x78,0x9C,0xE5,0x94,0xBF,0x4E,0xC2,0x40,0x1C,0xC7,0x7F,0x2D,0x04,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0x51,0x08};

void App_Show_WelcomeScreen(Gpu_Hal_Context_t *phost, char* info[])
{
    //CmdBuffer_Index = 0;

    Gpu_Hal_WrCmd32(phost,CMD_INFLATE);
    Gpu_Hal_WrCmd32(phost,START_ICON_ADDR);
#if defined(MSVC_PLATFORM) || defined(MSVC_FT800EMU)
    Gpu_Hal_WrCmdBuf(phost,home_start_icon,sizeof(home_start_icon)); //Load from RAM
#else
    Gpu_Hal_WrCmdBufFromFlash(phost,home_start_icon,sizeof(home_start_icon)); //Load from Flash
#endif

    Gpu_CoCmd_Dlstart(phost);        // start
    App_WrCoCmd_Buffer(phost,CLEAR(1,1,1));
    App_WrCoCmd_Buffer(phost,COLOR_RGB(255, 255, 255));

    App_WrCoCmd_Buffer(phost,BITMAP_HANDLE(START_ICON_HANDLE));    // handle for background stars
    App_WrCoCmd_Buffer(phost,BITMAP_SOURCE(START_ICON_ADDR));      // Starting address in gram
    App_WrCoCmd_Buffer(phost,BITMAP_LAYOUT(L4, 16, 32));  // format
    App_WrCoCmd_Buffer(phost,BITMAP_SIZE(NEAREST, BORDER, BORDER, 32, 32  ));

    App_WrCoCmd_Buffer(phost,DISPLAY());
    Gpu_CoCmd_Swap(phost);
    App_Flush_Co_Buffer(phost);
    Gpu_Hal_WaitCmdfifo_empty(phost);

    do
    {
        Gpu_CoCmd_Dlstart(phost);   
        App_WrCoCmd_Buffer(phost,BITMAP_TRANSFORM_A(256));
        App_WrCoCmd_Buffer(phost,BITMAP_TRANSFORM_A(256));
        App_WrCoCmd_Buffer(phost,BITMAP_TRANSFORM_B(0));
        App_WrCoCmd_Buffer(phost,BITMAP_TRANSFORM_C(0));
        App_WrCoCmd_Buffer(phost,BITMAP_TRANSFORM_D(0));
        App_WrCoCmd_Buffer(phost,BITMAP_TRANSFORM_E(256));
        App_WrCoCmd_Buffer(phost,BITMAP_TRANSFORM_F(0));  
        App_WrCoCmd_Buffer(phost,SAVE_CONTEXT());    
        App_WrCoCmd_Buffer(phost,COLOR_RGB(219,180,150));
        App_WrCoCmd_Buffer(phost,COLOR_A(220));
        App_WrCoCmd_Buffer(phost,BEGIN(EDGE_STRIP_A));
        App_WrCoCmd_Buffer(phost,VERTEX2F(0,DispHeight*16));
        App_WrCoCmd_Buffer(phost,VERTEX2F(DispWidth*16,DispHeight*16));
        App_WrCoCmd_Buffer(phost,COLOR_A(255));
        App_WrCoCmd_Buffer(phost,RESTORE_CONTEXT());    
        App_WrCoCmd_Buffer(phost,COLOR_RGB(0,0,0));
        // INFORMATION 
        Gpu_CoCmd_Text(phost,DispWidth/2,20,28,OPT_CENTERX|OPT_CENTERY,info[0]);
        Gpu_CoCmd_Text(phost,DispWidth/2,60,26,OPT_CENTERX|OPT_CENTERY,info[1]);
        Gpu_CoCmd_Text(phost,DispWidth/2,90,26,OPT_CENTERX|OPT_CENTERY,info[2]);  
        Gpu_CoCmd_Text(phost,DispWidth/2,120,26,OPT_CENTERX|OPT_CENTERY,info[3]);  
        Gpu_CoCmd_Text(phost,DispWidth/2,DispHeight-30,26,OPT_CENTERX|OPT_CENTERY,"Click to play");
        if(sk!='P')
        App_WrCoCmd_Buffer(phost,COLOR_RGB(255,255,255));
        else
        App_WrCoCmd_Buffer(phost,COLOR_RGB(100,100,100));
        App_WrCoCmd_Buffer(phost,BEGIN(FTPOINTS));   
        App_WrCoCmd_Buffer(phost,POINT_SIZE(20*16));
        App_WrCoCmd_Buffer(phost,TAG('P'));
        App_WrCoCmd_Buffer(phost,VERTEX2F((DispWidth/2)*16,(DispHeight-60)*16));
        App_WrCoCmd_Buffer(phost,COLOR_RGB(180,35,35));

        App_WrCoCmd_Buffer(phost,BEGIN(BITMAPS));
        App_WrCoCmd_Buffer(phost,VERTEX2II((DispWidth/2)-14,(DispHeight-75),START_ICON_HANDLE,4));
        App_WrCoCmd_Buffer(phost,END());

        //
        //    App_WrCoCmd_Buffer(phost, BITMAP_HANDLE(LOGO_ICON_HANDLE));
        //    App_WrCoCmd_Buffer(phost, BITMAP_SOURCE(RAM_G));      // Starting address in gram
        //    App_WrCoCmd_Buffer(phost,BITMAP_LAYOUT(L4, 20, 40));  // format
        //    App_WrCoCmd_Buffer(phost,BITMAP_SIZE(NEAREST, BORDER, BORDER, 40, 40  ));
        //
        //    App_WrCoCmd_Buffer(phost,BEGIN(BITMAPS));
        //    App_WrCoCmd_Buffer(phost,VERTEX2II(10,60,LOGO_ICON_HANDLE,0));
        //    App_WrCoCmd_Buffer(phost,END());

        App_WrCoCmd_Buffer(phost,DISPLAY());
        Gpu_CoCmd_Swap(phost);
        App_Flush_Co_Buffer(phost);
        Gpu_Hal_WaitCmdfifo_empty(phost);
    }while(App_Read_Tag(phost)!='P');
    App_Play_Sound(phost, 0x50,255,0xc0);
}


/*************************************************************************************************
                        THIS PART DRAW BRIDGETEK LOGO
*************************************************************************************************/
//#define LOGO_SCALE_ANIMATION
/* Use bridgetek animation as default */
#ifndef LOGO_SCALE_ANIMATION
PROGMEM prog_uchar8_t logo_graphics[6224] = {
120, 218, 237, 93, 127, 112, 36, 71, 117, 158, 221, 213, 207, 149, 116,
44, 190, 56, 56, 72, 156, 20, 2, 4, 167, 184, 72, 49, 113, 165, 42, 196,
58, 249, 42, 135, 77, 37, 172, 20, 199, 103, 42, 14, 142, 54, 63, 140,
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117, 33, 255, 15, 136, 52, 18, 253};

static const struct element {
  uint32_t src;
  uint16_t w, h, x0, y0;
} el[] = {
  { 0,      74, 145,  54,  48 },
  { 5365,  110, 218,  18,  11 },
  { 17355,  28,  29,   8,  66 },
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  { 62086, 602,  29, 190, 183 }
};

static int32_t scaling;
static int16_t YOFFSET;

#define FX16(x)   ((int32_t)((x) * 65536.0f))

static int32_t tween(int32_t t, int32_t a, int32_t b)
{
  uint16_t tu, tu2, tu3;
  if (t < 0)
    return a;
  if (t > 65535)
    return b;
  tu = t;
  tu = ~tu;
  tu2 = ((uint32_t)tu * tu) >> 16;
  tu3 = ((uint32_t)tu2 * tu) >> 16;
  tu3 = ~tu3;
  return a + (((int32_t)tu3 * (b - a)) >> 16);
}

int32_t dc(int16_t c)
{
  return (scaling * c) >> 12;
}
static void setup_element(Gpu_Hal_Context_t *phost, const struct element *e)
{
  App_WrCoCmd_Buffer(phost, BITMAP_SOURCE(e->src));
  App_WrCoCmd_Buffer(phost, BITMAP_LAYOUT(L4, e->w / 2, e->h));
  App_WrCoCmd_Buffer(phost, BITMAP_SIZE(BILINEAR,BORDER,BORDER,(dc(e->w) >> 4) + 1,(dc(e->h) >> 4) + 1));
#ifdef FT81X_ENABLE
  App_WrCoCmd_Buffer(phost, BITMAP_LAYOUT_H((e->w / 2)>>10, 0));
  App_WrCoCmd_Buffer(phost, BITMAP_SIZE_H(((dc(e->w) >> 4) + 1)>>9, ((dc(e->h) >> 4) + 1)>>9));
#endif
}

static void draw(Gpu_Hal_Context_t *phost, const struct element *e, int32_t x)
{
  setup_element(phost, e);
  App_WrCoCmd_Buffer(phost, VERTEX2F(dc(e->x0) + x, YOFFSET + dc(e->y0)));
}

void App_Show_Logo(Gpu_Hal_Context_t *phost)
{
#if defined (BT815_ENABLE)
	Gpu_CoCmd_Logo(phost);
#else
    uint16_t ff,frame,i;
    int32_t syo ;

    scaling = FX16(1) * DispWidth / 800;
    YOFFSET = ((DispHeight << 4) - dc(242)) / 2;
    syo = YOFFSET * (FX16(800 / 16) / DispWidth);
    
    #if defined(MSVC_PLATFORM) || defined(MSVC_FT800EMU)
        Gpu_Hal_WrCmd32(phost,CMD_INFLATE);
        Gpu_Hal_WrCmd32(phost,0);
        Gpu_Hal_WrCmdBuf(phost, logo_graphics, sizeof(logo_graphics));
    #else
        Gpu_CoCmd_Inflate(phost, 0);
        Gpu_Hal_WrCmdBufFromFlash(phost, logo_graphics, sizeof(logo_graphics));
    #endif
        App_Flush_Co_Buffer(phost);
        Gpu_Hal_WaitCmdfifo_empty(phost);
    
    for (frame = 0, ff = 0; frame < 120; frame++, ff += 550) {
        Gpu_CoCmd_Dlstart(phost);
        App_WrCoCmd_Buffer(phost, CLEAR_COLOR_RGB(255,255,255));
        App_WrCoCmd_Buffer(phost, CLEAR(1, 1, 1));
        App_WrCoCmd_Buffer(phost, BITMAP_HANDLE(LOGO_ICON_HANDLE));
        App_WrCoCmd_Buffer(phost, BEGIN(BITMAPS));

        Gpu_CoCmd_LoadIdentity(phost);
        Gpu_CoCmd_Scale(phost, scaling, scaling);
        Gpu_CoCmd_SetMatrix(phost);

        App_WrCoCmd_Buffer(phost, COLOR_RGB( 35,  31,  32)); // gray
        for (i = 0; i < 10; i++) {
            if (i == 9)
                App_WrCoCmd_Buffer(phost, COLOR_RGB(237,  28,  36)); // red
            draw(phost, &el[i], tween((ff - FX16(.1)) * 3 - FX16(.1) * i, dc(-130), 0));
        }

        App_WrCoCmd_Buffer(phost, COLOR_RGB( 56, 113, 193)); // blue
        App_WrCoCmd_Buffer(phost, SAVE_CONTEXT());
        setup_element(phost, &el[10]);
        App_WrCoCmd_Buffer(phost, BITMAP_SIZE(BILINEAR, BORDER, BORDER, 0, 0));
        Gpu_CoCmd_LoadIdentity(phost);
        Gpu_CoCmd_Scale(phost, scaling, scaling);
        Gpu_CoCmd_Translate(phost, (int32_t)el[10].x0 << 16, ((int32_t)el[10].y0 << 16) + syo + FX16(60));
        Gpu_CoCmd_Rotate(phost, -tween((ff - FX16(.1)) * 2, 0x4000, 0x0000));
        Gpu_CoCmd_Translate(phost, FX16(0), FX16(-60));
        Gpu_CoCmd_SetMatrix(phost);
        App_WrCoCmd_Buffer(phost, VERTEX2F(0, 0));
        App_WrCoCmd_Buffer(phost, RESTORE_CONTEXT());

        draw(phost, &el[11], tween((ff - FX16(.4)) * 3, dc(210), 0));

        App_WrCoCmd_Buffer(phost, COLOR_RGB( 35,  31,  32)); // gray
        App_WrCoCmd_Buffer(phost, COLOR_A(tween((ff - FX16(.75)) * 4, 0, 255)));
        draw(phost, &el[12], 0);

        App_WrCoCmd_Buffer(phost, DISPLAY());

        Gpu_CoCmd_Swap(phost);
        App_Flush_Co_Buffer(phost);
        Gpu_Hal_WaitCmdfifo_empty(phost);
    }
#endif
    /* Show dummy clear screen to clean up logo after animation */
    Gpu_CoCmd_Dlstart(phost);
    Gpu_ClearScreen(phost);
    App_Flush_Co_Buffer(phost);
    Gpu_Hal_WaitCmdfifo_empty(phost);
    Gpu_Hal_Sleep(20);
}
#else
#define LOGO_HEIGHT 80 
#define LOGO_WIDTH 264 
#define LOGO_STRIDE 528
#define LOGO_FMT   ARGB4
PROGMEM prog_uchar8_t logo[SIZE_LOGO] = {//bridgetek 6703 bytes
    //logo
    120,156,237,93,205,78,35,201,178,230,216,189,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101,
};


void App_Show_Logo(Gpu_Hal_Context_t *phost)
{

    uint32_t x, y, w, h;
    uint32_t step;
    #define TOTAL_STEP 8
    const float SCALE_INIT = 1.7;
    float scale = 1;

#if defined(MSVC_PLATFORM) || defined(MSVC_FT800EMU)
    Gpu_Hal_WrCmd32(phost,CMD_INFLATE);
    Gpu_Hal_WrCmd32(phost,0);
    Gpu_Hal_WrCmdBuf(phost, logo, sizeof(logo));
#else
    Gpu_CoCmd_Inflate(phost, 0);
    Gpu_Hal_WrCmdBufFromFlash(phost, logo, sizeof(logo));
#endif
    //Starting at SCALE_INIT times of orginial logo
    //Display animation: scale logo from SCALE_INIT to X1 size
    scale = SCALE_INIT;
    for (step = 1; step <= TOTAL_STEP; step++) {
        scale -= (SCALE_INIT-1)/TOTAL_STEP;
        x = (uint32_t)(DispWidth-scale*LOGO_WIDTH)/2;
        y = (uint32_t)(DispHeight-scale*LOGO_HEIGHT)/2;
        w = (uint32_t)(scale*LOGO_WIDTH);
        h = (uint32_t)(scale*LOGO_HEIGHT);

        Gpu_CoCmd_Dlstart(phost);
        App_WrCoCmd_Buffer(phost, CLEAR_TAG(1));
        App_WrCoCmd_Buffer(phost, CLEAR_COLOR_RGB(255,255,255));
        App_WrCoCmd_Buffer(phost, CLEAR(1, 1, 1));
        
        //Display Logo
        //App_WrCoCmd_Buffer(phost, COLOR_MASK(0, 0, 0, 0));
        App_WrCoCmd_Buffer(phost, COLOR_A(255));
        App_WrCoCmd_Buffer(phost, COLOR_RGB(255,255,255));
        App_WrCoCmd_Buffer(phost, BITMAP_HANDLE(LOGO_ICON_HANDLE));
        Gpu_CoCmd_LoadIdentity(phost);
        Gpu_CoCmd_Scale(phost, scale*65536L,scale*65536L);
        Gpu_CoCmd_SetMatrix(phost );
        //#ifdef FT81X_ENABLE
        //Gpu_CoCmd_SetBitmap(phost, 0, LOGO_FMT, w, h);
        //#else
        App_WrCoCmd_Buffer(phost,BITMAP_SOURCE(0));
        App_WrCoCmd_Buffer(phost,BITMAP_LAYOUT(LOGO_FMT, LOGO_STRIDE,LOGO_HEIGHT));
        App_WrCoCmd_Buffer(phost,BITMAP_SIZE(NEAREST, BORDER, BORDER, w, h));    
        //#endif
        App_WrCoCmd_Buffer(phost,BEGIN(BITMAPS));
        App_WrCoCmd_Buffer(phost, BITMAP_HANDLE(LOGO_ICON_HANDLE));
        
        App_WrCoCmd_Buffer(phost,VERTEX2F(x<<4 , y<<4));

        //DONE
        App_WrCoCmd_Buffer(phost,TAG_MASK(0));
        App_WrCoCmd_Buffer(phost,DISPLAY());
        App_Flush_Co_Buffer(phost);
        /*Swap the frame directly*/
        Gpu_Hal_Wr8(phost,REG_DLSWAP,DLSWAP_FRAME);
        Gpu_Hal_WaitCmdfifo_empty(phost);
        Gpu_Hal_Sleep(150);
    }
    /* Show dummy clear screen to clean up logo after animation */
    Gpu_CoCmd_Dlstart(phost);
    Gpu_ClearScreen(phost);
	App_Flush_Co_Buffer(phost);
    Gpu_Hal_WaitCmdfifo_empty(phost);
    Gpu_Hal_Sleep(150);
}

#endif
/******************** END DRAW BRIDGETEK LOGO ****************************/

/*************************************************************************************************
                        APP FUNCTIONALITIES
*************************************************************************************************/

void App_Common_Init(Gpu_Hal_Context_t *phost)
{

#if ( defined(FT900_PLATFORM) || defined(FT93X_PLATFORM) )
    FT9XX_Config();
#endif

    Gpu_HalInit_t halinit;
    
    halinit.TotalChannelNum = 1;

    
    Gpu_Hal_Init(&halinit);
    phost->hal_config.channel_no = 0;
    phost->hal_config.pdn_pin_no = FT800_PD_N;
    phost->hal_config.spi_cs_pin_no = FT800_SEL_PIN;

    #if defined(MSVC_PLATFORM) && defined(MSVC_PLATFORM_SPI_LIBMPSSE)
    phost->hal_config.spi_clockrate_khz = 12000; //in KHz
    #elif defined(MSVC_PLATFORM) && defined(MSVC_PLATFORM_SPI_LIBFT4222)
    #if defined(HAL_CLK_COMPUTE_TEST)
    FT4222_ClockRate selclk = 0;
    FT4222_SPIClock seldiv = 0;

    phost->hal_config.spi_clockrate_khz = 1;
    while (phost->hal_config.spi_clockrate_khz < 30001)
    {
        /*User requested SPI communication clock is in host->hal_config.spi_clockrate_khz
                Finding FT422 system clock and divider to provide this. If not nearest possible
                available communication clock will be chosen
                */
        if (!Gpu_Hal_FT4222_ComputeCLK(&host, &selclk, &seldiv))
        {
            printf("Requested clock %d KHz is not supported in FT4222 \n", phost->hal_config.spi_clockrate_khz);
            return 0;
        }
        phost->hal_config.spi_clockrate_khz += 1;
    }
    fflush(stdout);
    #else
    phost->hal_config.spi_clockrate_khz = 20000; //in KHz
    #endif
    #elif defined( ARDUINO_PLATFORM_SPI)
    phost->hal_config.spi_clockrate_khz = 4000; //in KHz
    #else /* FT900_PLATFORM or FT93X_PLATFORM */
    phost->hal_config.spi_clockrate_khz = 20000;
    #endif
    Gpu_Hal_Open(phost);
    BootupConfig(phost);

#if (defined (FT900_PLATFORM) || defined(FT900_PLATFORM) || defined(MSVC_PLATFORM))
    printf("\n reg_touch_rz =0x%x ", Gpu_Hal_Rd16(phost, REG_TOUCH_RZ));
    printf("\n reg_touch_rzthresh =0x%x ", Gpu_Hal_Rd32(phost, REG_TOUCH_RZTHRESH));
    printf("\n reg_touch_tag_xy=0x%x",Gpu_Hal_Rd32(phost, REG_TOUCH_TAG_XY));
    printf("\n reg_touch_tag=0x%x",Gpu_Hal_Rd32(phost, REG_TOUCH_TAG));
#endif

    Gpu_ClearScreen(phost);
    
    Gpu_Hal_Sleep(1000);//Show the booting up screen.


}

/**
* This function shows Bridgetek logo, Calibration and Welcome screen
* Display the application information in info array
* @Return: None
*/
void App_Common_Start(Gpu_Hal_Context_t *phost, char* info[])
{
    /* Screen Calibration*/
    App_Calibrate_Screen(phost);

    /* Show Bridgetek logo */
    App_Show_Logo(phost);

    /* Show welcome screen, waiting user to press Play button */
    App_Show_WelcomeScreen(phost,info);
}

void App_Common_Close(Gpu_Hal_Context_t *phost)
{
    /* Close all the opened handles */
    Gpu_Hal_Close(phost);
    Gpu_Hal_DeInit();
}


/*************************************************************************************************
                        Application utilities
*************************************************************************************************/
